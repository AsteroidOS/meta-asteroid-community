## conf/layer.conf
```bitbake
# We have a conf and classes directory, append to BBPATH
BBPATH .= ":${LAYERDIR}"

# We have a recipes directory, add to BBFILES
BBFILES += "${LAYERDIR}/recipes*/*/*.bb ${LAYERDIR}/recipes*/*/*.bbappend"

BBFILE_COLLECTIONS += "asteroid-community-layer"
BBFILE_PATTERN_asteroid-community-layer := "^${LAYERDIR}/"
BBFILE_PRIORITY_asteroid-community-layer = "7"

LAYERSERIES_COMPAT_asteroid-community-layer = "walnascar"

PACKAGE_FEED += " \
    neofetch asteroid-qmltester vim desktop-file-utils nano unofficial-watchfaces cronie asteroid-map \
    asteroid-weatherfetch asteroid-sensorlogd asteroid-health asteroid-dodger asteroid-skedaddle asteroid-blaster asteroid-shopper \
"
```
